## config/board/arm/plancktex/Kconfig.board
```kconfig
config BOARD_PLANCKTEX
       bool "PlanckTeX"
       depends on SOC_NRF52840_QIAA
```

## config/boards/arm/plancktex/Kconfig.board
```kconfig
config BOARD_PLANCKTEX
       bool "plancktex"
       depends on SOC_NRF52840_QIAA
```

## config/boards/arm/plancktex/Kconfig.defconfig
```kconfig
config BOARD
       default "plancktex"

config USB_NRFX
       default y

config USB_DEVICE_STACK
       default y

config BT_CTLR
       default BT

config ZMK_BLE
       default y

config ZMK_USB
       default y

#config PINMUX
#       default y

config ZMK_USB_LOGGING
       default y

#config BOARD_NRFMICRO_CHARGER
#	default y

#config ZMK_BATTERY_VOLTAGE_DIVIDER
#	default y
```
